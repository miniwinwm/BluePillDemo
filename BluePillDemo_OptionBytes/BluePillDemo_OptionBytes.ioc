# file: BluePillDemo_OptionBytes.ioc
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Mcu.Family=STM32F1
Mcu.Name=STM32F103C(8-B)Tx
Mcu.Package=LQFP48
NVIC.PriorityGroup=NVIC_PRIORITYGROUP_4
PA13.Mode=Serial_Wire
PA13.Signal=SYS_JTMS-SWDIO
PA14.Mode=Serial_Wire
PA14.Signal=SYS_JTCK-SWCLK
ProjectManager.HeapSize=0x200
ProjectManager.StackSize=0x400
ProjectManager.TargetToolchain=STM32CubeIDE
RCC.APB1Freq_Value=8000000
RCC.APB2Freq_Value=8000000
board=custom

// file: Core/Src/main.c
/* USER CODE BEGIN Header */
/**
  ******************************************************************************
  * @file           : main.c
  * @brief          : Main program body
  ******************************************************************************
  * @attention
  *
  * <h2><center>&copy; Copyright (c) 2020 STMicroelectronics.
  * All rights reserved.</center></h2>
  *
  * This software component is licensed by ST under BSD 3-Clause license,
  * the "License"; You may not use this file except in compliance with the
  * License. You may obtain a copy of the License at:
  *                        opensource.org/licenses/BSD-3-Clause
  *
  ******************************************************************************
  */
/* USER CODE END Header */

#include "main.h"

void SystemClock_Config(void);
static void MX_GPIO_Init(void);

int main(void)
{

  /* MCU Configuration--------------------------------------------------------*/

  /* Reset of all peripherals, Initializes the Flash interface and the Systick. */
  HAL_Init();

  /* Configure the system clock */
  SystemClock_Config();

  /* Initialize all configured peripherals */
  MX_GPIO_Init();
  /* USER CODE BEGIN 2 */

  uint32_t ud;

  // get existing user data bytes - note, it is actually a single byte each time but the API returns a uint32_t
  ud = HAL_FLASHEx_OBGetUserData(OB_DATA_ADDRESS_DATA0);
  ud = HAL_FLASHEx_OBGetUserData(OB_DATA_ADDRESS_DATA1);

  // create and fill in a representation of the non-user data parts of the option bytes
  FLASH_OBProgramInitTypeDef option_bytes;
  HAL_FLASHEx_OBGetConfig(&option_bytes);

  // set the bytes we want to write back, this must include the non-user data parts of the option bytes as they will be erased
  option_bytes.OptionType = OPTIONBYTE_WRP | OPTIONBYTE_RDP | OPTIONBYTE_USER | OPTIONBYTE_DATA;

  // set which user data byte to write and its value for the first user data byte
  option_bytes.DATAAddress = OB_DATA_ADDRESS_DATA0;
  option_bytes.DATAData = 0x55;

  // unlock flash
  HAL_FLASH_Unlock();
  HAL_FLASH_OB_Unlock();

  // write the option bytes (non-user data parts and 1 user data byte), this does an erase first internally when
  // writing the non-user data option bytes
  HAL_FLASHEx_OBProgram(&option_bytes);

  // set which user data byte to write and its value for the second user data byte
  option_bytes.DATAAddress = OB_DATA_ADDRESS_DATA1;
  option_bytes.DATAData = 0xcc;

  // no need to do another erase so no need to write all the non-user data option bytes and as
  // only writing a user data byte this time choose just that and then write it
  option_bytes.OptionType = OPTIONBYTE_DATA;
  HAL_FLASHEx_OBProgram(&option_bytes);

  // lock the flash again
  HAL_FLASH_OB_Lock();
  HAL_FLASH_Lock();

  // re-read the user data 2 bytes again to check
  ud = HAL_FLASHEx_OBGetUserData(OB_DATA_ADDRESS_DATA0);
  ud = HAL_FLASHEx_OBGetUserData(OB_DATA_ADDRESS_DATA1);
  (void)ud;

  /* USER CODE END 2 */

  /* Infinite loop */
  while (1)
  {

  }
}

void SystemClock_Config(void)
{
  RCC_OscInitTypeDef RCC_OscInitStruct = {0};
  RCC_ClkInitTypeDef RCC_ClkInitStruct = {0};

  /** Initializes the CPU, AHB and APB busses clocks
  */
  RCC_OscInitStruct.OscillatorType = RCC_OSCILLATORTYPE_HSI;
  RCC_OscInitStruct.HSIState = RCC_HSI_ON;
  RCC_OscInitStruct.HSICalibrationValue = RCC_HSICALIBRATION_DEFAULT;
  RCC_OscInitStruct.PLL.PLLState = RCC_PLL_NONE;
  if (HAL_RCC_OscConfig(&RCC_OscInitStruct) != HAL_OK)
  {
    Error_Handler();
  }
  /** Initializes the CPU, AHB and APB busses clocks
  */
  RCC_ClkInitStruct.ClockType = RCC_CLOCKTYPE_HCLK|RCC_CLOCKTYPE_SYSCLK
                              |RCC_CLOCKTYPE_PCLK1|RCC_CLOCKTYPE_PCLK2;
  RCC_ClkInitStruct.SYSCLKSource = RCC_SYSCLKSOURCE_HSI;
  RCC_ClkInitStruct.AHBCLKDivider = RCC_SYSCLK_DIV1;
  RCC_ClkInitStruct.APB1CLKDivider = RCC_HCLK_DIV1;
  RCC_ClkInitStruct.APB2CLKDivider = RCC_HCLK_DIV1;

  if (HAL_RCC_ClockConfig(&RCC_ClkInitStruct, FLASH_LATENCY_0) != HAL_OK)
  {
    Error_Handler();
  }
}

static void MX_GPIO_Init(void)
{

  /* GPIO Ports Clock Enable */
  __HAL_RCC_GPIOA_CLK_ENABLE();

}

void Error_Handler(void)
{
}

/************************ (C) COPYRIGHT STMicroelectronics *****END OF FILE****/
